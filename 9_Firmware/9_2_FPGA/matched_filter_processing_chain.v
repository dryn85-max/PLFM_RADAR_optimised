`timescale 1ns / 1ps

/**
 * matched_filter_processing_chain.v
 *
 * Pulse compression for one N_FFT-point segment:
 *   FFT(signal) -> x conj(REF[ref_segment]) -> IFFT -> range profile
 *
 * The reference spectrum comes precomputed from ref_spectrum_rom.v
 * (generated by tb/golden/gen_ref_spectrum.py), so the engine runs only two
 * passes per segment (forward + inverse).
 *
 * Two implementations, selected at compile time:
 *   `ifdef SIMULATION : behavioral in-place FFT with float twiddles (fast for
 *                       the integration testbenches; NOT bit-exact)
 *   else              : synthesizable — one fft_engine (N_FFT, 25-bit internal,
 *                       4 multipliers), frequency_matched_filter (4 multipliers),
 *                       two inferable RAM buffers (sig, prod) 2 x 256 x 16 each
 *                       and the reference ROM.
 * tb/tb_mf_chain.v is compiled both ways by run_regression.sh.
 *
 * Interface:
 *   adc_data_i/q, adc_valid   N_FFT samples per frame (16-bit, two's complement)
 *   ref_segment               0..3 long-chirp segment, 4 short chirp
 *   range_profile_i/q/valid   N_FFT outputs streamed one per clock
 *   chain_state               0 = IDLE (segmenter waits for this)
 *
 * Multipliers: synthesizable branch 4 (engine) + 4 (conj-multiply) = 8.
 * RAM: engine 2 x 256 x 25, sig/prod 4 x 256 x 16, ROM 2 x 1280 x 16.
 */

module matched_filter_processing_chain #(
    parameter N_FFT = 256,
    parameter LOG2N = 8
)(
    input wire clk,
    input wire reset_n,

    input wire [15:0] adc_data_i,
    input wire [15:0] adc_data_q,
    input wire adc_valid,

    input wire [5:0] chirp_counter,
    input wire [2:0] ref_segment,

    output wire signed [15:0] range_profile_i,
    output wire signed [15:0] range_profile_q,
    output wire range_profile_valid,

    output wire [3:0] chain_state
);

`ifdef SIMULATION
// ============================================================================
// BEHAVIORAL IMPLEMENTATION (simulation only, float twiddles)
// ============================================================================
localparam [3:0] ST_IDLE          = 4'd0;
localparam [3:0] ST_FWD_FFT       = 4'd1;   // collect samples + bit-reverse
localparam [3:0] ST_FWD_BUTTERFLY = 4'd2;
localparam [3:0] ST_MULTIPLY      = 4'd3;
localparam [3:0] ST_INV_BITREV    = 4'd4;
localparam [3:0] ST_INV_BUTTERFLY = 4'd5;
localparam [3:0] ST_OUTPUT        = 4'd6;
localparam [3:0] ST_DONE          = 4'd7;

reg [3:0] state;
reg [LOG2N:0] fwd_in_count;
reg fwd_frame_done;

reg signed [15:0] fwd_buf_i  [0:N_FFT-1];
reg signed [15:0] fwd_buf_q  [0:N_FFT-1];
reg signed [15:0] fwd_out_i  [0:N_FFT-1];
reg signed [15:0] fwd_out_q  [0:N_FFT-1];
reg signed [15:0] mult_out_i [0:N_FFT-1];
reg signed [15:0] mult_out_q [0:N_FFT-1];
reg signed [15:0] ifft_out_i [0:N_FFT-1];
reg signed [15:0] ifft_out_q [0:N_FFT-1];
reg signed [31:0] work_re    [0:N_FFT-1];
reg signed [31:0] work_im    [0:N_FFT-1];

// Reference spectra (same .mem files as ref_spectrum_rom.v)
reg [15:0] ref_rom_i [0:5*N_FFT-1];
reg [15:0] ref_rom_q [0:5*N_FFT-1];
initial begin
    $readmemh("ref_spectrum_i.mem", ref_rom_i);
    $readmemh("ref_spectrum_q.mem", ref_rom_q);
end

reg [LOG2N:0] out_count;
reg out_valid_reg;
reg signed [15:0] out_i_reg, out_q_reg;

function [LOG2N-1:0] bit_reverse;
    input [LOG2N-1:0] val;
    integer b;
    begin
        bit_reverse = 0;
        for (b = 0; b < LOG2N; b = b + 1)
            bit_reverse[LOG2N-1-b] = val[b];
    end
endfunction

integer fft_stage, fft_k, fft_j, fft_half, fft_span;
integer fft_idx_even, fft_idx_odd;
reg signed [31:0] tw_re, tw_im, t_re, t_im, u_re, u_im;
reg signed [63:0] p_re, p_im;
real tw_angle;
integer i;

task butterflies;
    input integer sign;   // -1 forward, +1 inverse
    begin
        for (fft_stage = 0; fft_stage < LOG2N; fft_stage = fft_stage + 1) begin
            fft_half = 1 << fft_stage;
            fft_span = fft_half << 1;
            for (fft_k = 0; fft_k < N_FFT; fft_k = fft_k + fft_span) begin
                for (fft_j = 0; fft_j < fft_half; fft_j = fft_j + 1) begin
                    fft_idx_even = fft_k + fft_j;
                    fft_idx_odd  = fft_idx_even + fft_half;
                    tw_angle = sign * 2.0 * 3.14159265358979 * fft_j / (fft_span * 1.0);
                    tw_re = $rtoi($cos(tw_angle) * 32767.0);
                    tw_im = $rtoi($sin(tw_angle) * 32767.0);
                    // 64-bit products: 32 x 32 would overflow once |work| > 2^16
                    // (the IFFT sees values up to N x the spectrum amplitude)
                    p_re = work_re[fft_idx_odd] * tw_re - work_im[fft_idx_odd] * tw_im;
                    p_im = work_re[fft_idx_odd] * tw_im + work_im[fft_idx_odd] * tw_re;
                    t_re = p_re >>> 15;
                    t_im = p_im >>> 15;
                    u_re = work_re[fft_idx_even];
                    u_im = work_im[fft_idx_even];
                    work_re[fft_idx_even] = u_re + t_re;
                    work_im[fft_idx_even] = u_im + t_im;
                    work_re[fft_idx_odd]  = u_re - t_re;
                    work_im[fft_idx_odd]  = u_im - t_im;
                end
            end
        end
    end
endtask

function signed [15:0] sat16;
    input signed [31:0] v;
    begin
        if (v > 32767)       sat16 = 16'sh7FFF;
        else if (v < -32768) sat16 = 16'sh8000;
        else                 sat16 = v[15:0];
    end
endfunction

always @(posedge clk or negedge reset_n) begin
    if (!reset_n) begin
        state <= ST_IDLE; fwd_in_count <= 0; fwd_frame_done <= 0;
        out_count <= 0; out_valid_reg <= 0; out_i_reg <= 0; out_q_reg <= 0;
    end else begin
        out_valid_reg <= 1'b0;
        case (state)
        ST_IDLE: begin
            fwd_in_count <= 0; fwd_frame_done <= 0; out_count <= 0;
            if (adc_valid) begin
                fwd_buf_i[0] <= $signed(adc_data_i);
                fwd_buf_q[0] <= $signed(adc_data_q);
                fwd_in_count <= 1;
                state <= ST_FWD_FFT;
            end
        end
        ST_FWD_FFT: begin
            if (!fwd_frame_done) begin
                if (adc_valid && fwd_in_count < N_FFT) begin
                    fwd_buf_i[fwd_in_count] <= $signed(adc_data_i);
                    fwd_buf_q[fwd_in_count] <= $signed(adc_data_q);
                    fwd_in_count <= fwd_in_count + 1;
                end
                if (fwd_in_count == N_FFT) begin
                    fwd_frame_done <= 1;
                    for (i = 0; i < N_FFT; i = i + 1) begin
                        work_re[bit_reverse(i[LOG2N-1:0])] <= {{16{fwd_buf_i[i][15]}}, fwd_buf_i[i]};
                        work_im[bit_reverse(i[LOG2N-1:0])] <= {{16{fwd_buf_q[i][15]}}, fwd_buf_q[i]};
                    end
                end
            end else begin
                state <= ST_FWD_BUTTERFLY;
            end
        end
        ST_FWD_BUTTERFLY: begin
            butterflies(-1);
            for (i = 0; i < N_FFT; i = i + 1) begin
                fwd_out_i[i] <= sat16(work_re[i]);
                fwd_out_q[i] <= sat16(work_im[i]);
            end
            state <= ST_MULTIPLY;
        end
        ST_MULTIPLY: begin
            // (a+jb)(c-jd) = (ac+bd) + j(bc-ad), Q15 x Q15 -> Q15 (same as frequency_matched_filter)
            for (i = 0; i < N_FFT; i = i + 1) begin : mult_loop
                reg signed [31:0] a, b, c, d, re_sum, im_sum;
                a = {{16{fwd_out_i[i][15]}}, fwd_out_i[i]};
                b = {{16{fwd_out_q[i][15]}}, fwd_out_q[i]};
                c = {{16{ref_rom_i[{ref_segment, i[LOG2N-1:0]}][15]}}, ref_rom_i[{ref_segment, i[LOG2N-1:0]}]};
                d = {{16{ref_rom_q[{ref_segment, i[LOG2N-1:0]}][15]}}, ref_rom_q[{ref_segment, i[LOG2N-1:0]}]};
                re_sum = (a * c + b * d + 32'sh4000) >>> 15;
                im_sum = (b * c - a * d + 32'sh4000) >>> 15;
                mult_out_i[i] <= sat16(re_sum);
                mult_out_q[i] <= sat16(im_sum);
            end
            state <= ST_INV_BITREV;
        end
        ST_INV_BITREV: begin
            for (i = 0; i < N_FFT; i = i + 1) begin
                work_re[bit_reverse(i[LOG2N-1:0])] <= {{16{mult_out_i[i][15]}}, mult_out_i[i]};
                work_im[bit_reverse(i[LOG2N-1:0])] <= {{16{mult_out_q[i][15]}}, mult_out_q[i]};
            end
            state <= ST_INV_BUTTERFLY;
        end
        ST_INV_BUTTERFLY: begin
            butterflies(1);
            for (i = 0; i < N_FFT; i = i + 1) begin
                ifft_out_i[i] <= sat16(work_re[i] >>> LOG2N);
                ifft_out_q[i] <= sat16(work_im[i] >>> LOG2N);
            end
            state <= ST_OUTPUT;
        end
        ST_OUTPUT: begin
            if (out_count < N_FFT) begin
                out_i_reg <= ifft_out_i[out_count];
                out_q_reg <= ifft_out_q[out_count];
                out_valid_reg <= 1'b1;
                out_count <= out_count + 1;
            end else begin
                state <= ST_DONE;
            end
        end
        ST_DONE: state <= ST_IDLE;
        default: state <= ST_IDLE;
        endcase
    end
end

assign range_profile_i     = out_i_reg;
assign range_profile_q     = out_q_reg;
assign range_profile_valid = out_valid_reg;
assign chain_state         = state;

integer init_idx;
initial begin
    for (init_idx = 0; init_idx < N_FFT; init_idx = init_idx + 1) begin
        fwd_buf_i[init_idx] = 0; fwd_buf_q[init_idx] = 0; fwd_out_i[init_idx] = 0; fwd_out_q[init_idx] = 0;
        mult_out_i[init_idx] = 0; mult_out_q[init_idx] = 0; ifft_out_i[init_idx] = 0; ifft_out_q[init_idx] = 0;
        work_re[init_idx] = 0; work_im[init_idx] = 0;
    end
end

`else
// ============================================================================
// SYNTHESIZABLE IMPLEMENTATION — fft_engine (FFT + IFFT) + ref ROM
// ============================================================================
localparam [3:0] ST_IDLE     = 4'd0,
                 ST_COLLECT  = 4'd1,   // collect N_FFT samples into sig_buf
                 ST_SIG_FFT  = 4'd2,   // feed sig_buf -> engine, capture FFT into sig_buf
                 ST_SIG_CAP  = 4'd3,
                 ST_MULTIPLY = 4'd4,   // sig_buf x conj(ROM) -> prod_buf
                 ST_INV_FFT  = 4'd5,   // feed prod_buf -> engine (inverse), capture into prod_buf
                 ST_INV_CAP  = 4'd6,
                 ST_OUTPUT   = 4'd7,   // stream prod_buf
                 ST_DONE     = 4'd8;

reg [3:0] state;

// Buffers (inferable RAM: one write + one sync read per always block)
reg signed [15:0] sig_buf_i  [0:N_FFT-1];
reg signed [15:0] sig_buf_q  [0:N_FFT-1];
reg signed [15:0] prod_buf_i [0:N_FFT-1];
reg signed [15:0] prod_buf_q [0:N_FFT-1];
reg signed [15:0] sig_rdata_i, sig_rdata_q;
reg signed [15:0] prod_rdata_i, prod_rdata_q;

reg [LOG2N:0] fwd_in_count;   // collection counter (0..N_FFT)
reg [LOG2N:0] feed_count;
reg [LOG2N:0] cap_count;
reg [LOG2N:0] mult_count;
reg [LOG2N:0] out_count;
reg feed_primed, mult_primed, out_primed;

// FFT engine
reg fft_start, fft_inverse, fft_din_valid;
reg signed [15:0] fft_din_re, fft_din_im;
wire signed [15:0] fft_dout_re, fft_dout_im;
wire fft_dout_valid, fft_busy, fft_done;

fft_engine #(
    .N(N_FFT), .LOG2N(LOG2N), .DATA_W(16), .INTERNAL_W(25), .TWIDDLE_W(16),
    .TWIDDLE_FILE("fft_twiddle_256.mem")
) fft_inst (
    .clk(clk), .reset_n(reset_n), .start(fft_start), .inverse(fft_inverse),
    .din_re(fft_din_re), .din_im(fft_din_im), .din_valid(fft_din_valid),
    .dout_re(fft_dout_re), .dout_im(fft_dout_im), .dout_valid(fft_dout_valid),
    .busy(fft_busy), .done(fft_done));

// Reference ROM — addressed in lock-step with sig_buf during MULTIPLY
wire [LOG2N-1:0] mult_addr = (mult_count < N_FFT) ? mult_count[LOG2N-1:0] : {LOG2N{1'b0}};
wire signed [15:0] rom_i, rom_q;

ref_spectrum_rom #(.N_FFT(N_FFT), .LOG2N(LOG2N)) rom_inst (
    .clk(clk), .addr({ref_segment, mult_addr}), .dout_i(rom_i), .dout_q(rom_q));

// Conjugate multiply
reg signed [15:0] mf_sig_re, mf_sig_im, mf_ref_re, mf_ref_im;
reg mf_valid_in;
wire signed [15:0] mf_out_re, mf_out_im;
wire mf_valid_out;

frequency_matched_filter mf_inst (
    .clk(clk), .reset_n(reset_n),
    .fft_real_in(mf_sig_re), .fft_imag_in(mf_sig_im), .fft_valid_in(mf_valid_in),
    .ref_chirp_real(mf_ref_re), .ref_chirp_imag(mf_ref_im),
    .filtered_real(mf_out_re), .filtered_imag(mf_out_im), .filtered_valid(mf_valid_out),
    .state());

reg out_valid_reg;
reg signed [15:0] out_i_reg, out_q_reg;

// ---- sig_buf port ----
always @(posedge clk) begin : sig_bram_port
    reg we; reg [LOG2N-1:0] addr; reg signed [15:0] wdata_i, wdata_q;
    we = 1'b0; addr = 0; wdata_i = 0; wdata_q = 0;
    case (state)
    ST_IDLE:    if (adc_valid) begin we = 1'b1; addr = 0; wdata_i = $signed(adc_data_i); wdata_q = $signed(adc_data_q); end
    ST_COLLECT: if (adc_valid && fwd_in_count < N_FFT) begin
                    we = 1'b1; addr = fwd_in_count[LOG2N-1:0]; wdata_i = $signed(adc_data_i); wdata_q = $signed(adc_data_q);
                end
    ST_SIG_FFT: begin
        if (feed_count < N_FFT) addr = feed_count[LOG2N-1:0];
        if (fft_dout_valid && cap_count < N_FFT) begin
            we = 1'b1; addr = cap_count[LOG2N-1:0]; wdata_i = fft_dout_re; wdata_q = fft_dout_im;
        end
    end
    ST_SIG_CAP: if (fft_dout_valid && cap_count < N_FFT) begin
                    we = 1'b1; addr = cap_count[LOG2N-1:0]; wdata_i = fft_dout_re; wdata_q = fft_dout_im;
                end
    ST_MULTIPLY: addr = mult_addr;
    default: ;
    endcase
    if (we) begin
        sig_buf_i[addr] <= wdata_i;
        sig_buf_q[addr] <= wdata_q;
    end
    sig_rdata_i <= sig_buf_i[addr];
    sig_rdata_q <= sig_buf_q[addr];
end

// ---- prod_buf port ----
always @(posedge clk) begin : prod_bram_port
    reg we; reg [LOG2N-1:0] addr; reg signed [15:0] wdata_i, wdata_q;
    we = 1'b0; addr = 0; wdata_i = 0; wdata_q = 0;
    case (state)
    ST_MULTIPLY: if (mf_valid_out && cap_count < N_FFT) begin
                     we = 1'b1; addr = cap_count[LOG2N-1:0]; wdata_i = mf_out_re; wdata_q = mf_out_im;
                 end
    ST_INV_FFT: begin
        if (feed_count < N_FFT) addr = feed_count[LOG2N-1:0];
        if (fft_dout_valid && cap_count < N_FFT) begin
            we = 1'b1; addr = cap_count[LOG2N-1:0]; wdata_i = fft_dout_re; wdata_q = fft_dout_im;
        end
    end
    ST_INV_CAP: if (fft_dout_valid && cap_count < N_FFT) begin
                    we = 1'b1; addr = cap_count[LOG2N-1:0]; wdata_i = fft_dout_re; wdata_q = fft_dout_im;
                end
    ST_OUTPUT:  if (out_count < N_FFT) addr = out_count[LOG2N-1:0];
    default: ;
    endcase
    if (we) begin
        prod_buf_i[addr] <= wdata_i;
        prod_buf_q[addr] <= wdata_q;
    end
    prod_rdata_i <= prod_buf_i[addr];
    prod_rdata_q <= prod_buf_q[addr];
end

// ---- main FSM ----
always @(posedge clk or negedge reset_n) begin
    if (!reset_n) begin
        state <= ST_IDLE; fwd_in_count <= 0; feed_count <= 0; cap_count <= 0; mult_count <= 0; out_count <= 0;
        feed_primed <= 0; mult_primed <= 0; out_primed <= 0;
        fft_start <= 0; fft_inverse <= 0; fft_din_re <= 0; fft_din_im <= 0; fft_din_valid <= 0;
        mf_sig_re <= 0; mf_sig_im <= 0; mf_ref_re <= 0; mf_ref_im <= 0; mf_valid_in <= 0;
        out_valid_reg <= 0; out_i_reg <= 0; out_q_reg <= 0;
    end else begin
        fft_start <= 1'b0; fft_din_valid <= 1'b0; mf_valid_in <= 1'b0; out_valid_reg <= 1'b0;
        case (state)
        ST_IDLE: begin
            fwd_in_count <= 0; feed_primed <= 0; mult_primed <= 0; out_primed <= 0;
            if (adc_valid) begin fwd_in_count <= 1; state <= ST_COLLECT; end
        end
        ST_COLLECT: begin
            if (adc_valid && fwd_in_count < N_FFT) fwd_in_count <= fwd_in_count + 1;
            if (fwd_in_count == N_FFT) begin
                state <= ST_SIG_FFT; fft_start <= 1'b1; fft_inverse <= 1'b0;
                feed_count <= 0; cap_count <= 0; feed_primed <= 0;
            end
        end
        ST_SIG_FFT: begin
            if (feed_count < N_FFT) begin
                if (!feed_primed) begin feed_primed <= 1'b1; feed_count <= feed_count + 1; end
                else begin fft_din_re <= sig_rdata_i; fft_din_im <= sig_rdata_q; fft_din_valid <= 1'b1; feed_count <= feed_count + 1; end
            end else if (feed_count == N_FFT && feed_primed) begin
                fft_din_re <= sig_rdata_i; fft_din_im <= sig_rdata_q; fft_din_valid <= 1'b1; feed_count <= feed_count + 1;
            end
            if (fft_dout_valid && cap_count < N_FFT) cap_count <= cap_count + 1;
            if (fft_done) state <= ST_SIG_CAP;
        end
        ST_SIG_CAP: begin
            if (fft_dout_valid && cap_count < N_FFT) cap_count <= cap_count + 1;
            state <= ST_MULTIPLY; mult_count <= 0; cap_count <= 0; mult_primed <= 0;
        end
        ST_MULTIPLY: begin
            if (mult_count < N_FFT) begin
                if (!mult_primed) begin mult_primed <= 1'b1; mult_count <= mult_count + 1; end
                else begin
                    mf_sig_re <= sig_rdata_i; mf_sig_im <= sig_rdata_q; mf_ref_re <= rom_i; mf_ref_im <= rom_q;
                    mf_valid_in <= 1'b1; mult_count <= mult_count + 1;
                end
            end else if (mult_count == N_FFT && mult_primed) begin
                mf_sig_re <= sig_rdata_i; mf_sig_im <= sig_rdata_q; mf_ref_re <= rom_i; mf_ref_im <= rom_q;
                mf_valid_in <= 1'b1; mult_count <= mult_count + 1;
            end
            if (mf_valid_out && cap_count < N_FFT) cap_count <= cap_count + 1;
            if (cap_count == N_FFT) begin
                state <= ST_INV_FFT; fft_start <= 1'b1; fft_inverse <= 1'b1;
                feed_count <= 0; cap_count <= 0; feed_primed <= 0;
            end
        end
        ST_INV_FFT: begin
            if (feed_count < N_FFT) begin
                if (!feed_primed) begin feed_primed <= 1'b1; feed_count <= feed_count + 1; end
                else begin fft_din_re <= prod_rdata_i; fft_din_im <= prod_rdata_q; fft_din_valid <= 1'b1; feed_count <= feed_count + 1; end
            end else if (feed_count == N_FFT && feed_primed) begin
                fft_din_re <= prod_rdata_i; fft_din_im <= prod_rdata_q; fft_din_valid <= 1'b1; feed_count <= feed_count + 1;
            end
            if (fft_dout_valid && cap_count < N_FFT) cap_count <= cap_count + 1;
            if (fft_done) state <= ST_INV_CAP;
        end
        ST_INV_CAP: begin
            if (fft_dout_valid && cap_count < N_FFT) cap_count <= cap_count + 1;
            state <= ST_OUTPUT; out_count <= 0; out_primed <= 0;
        end
        ST_OUTPUT: begin
            if (out_count < N_FFT) begin
                if (!out_primed) begin out_primed <= 1'b1; out_count <= out_count + 1; end
                else begin out_i_reg <= prod_rdata_i; out_q_reg <= prod_rdata_q; out_valid_reg <= 1'b1; out_count <= out_count + 1; end
            end else if (out_count == N_FFT && out_primed) begin
                out_i_reg <= prod_rdata_i; out_q_reg <= prod_rdata_q; out_valid_reg <= 1'b1; out_count <= out_count + 1;
            end else begin
                state <= ST_DONE;
            end
        end
        ST_DONE: state <= ST_IDLE;
        default: state <= ST_IDLE;
        endcase
    end
end

assign range_profile_i     = out_i_reg;
assign range_profile_q     = out_q_reg;
assign range_profile_valid = out_valid_reg;
assign chain_state         = state;

`endif

endmodule
